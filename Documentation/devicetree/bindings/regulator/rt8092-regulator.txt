## Documentation/devicetree/bindings/regulator/rt8092-regulator.txt
```
RT8092XXX regulators

Required properties:
- compatible: "richtek,rt8092"
- reg: I2C slave address
- Vout-max: Max output voltage limit in uV programmed into the IC
- Vout-max: Min output voltage limit in uV programmed into the IC

Optional properties:
- Vsel-high: Indicates the VSEL pin is high.
  If this property is missing, assume the VSEL pin is low(0).

Any standard regulator properties can be used to configure the single regulator.

Example:

	i2c2 : i2c@80051f00{
		vsys_rt8092_reg: rt8092@1c{
			compatible = "richtek,rt8092";
			reg = <0x1c>;
			Vout-min = <1150000>;
			Vout-max = <1300000>;
			status = "okay";

			regulators {
				vsys_v1p3: rt8092_reg {
					regulator-name = "VSYS";
					regulator-min-microvolt = <1200000>;
					regulator-max-microvolt = <1400000>;
					regulator-always-on;
				};
			};
		};
	};
```

## arch/arm/Kconfig.sonos
```kconfig
config SONOS_DEVICE
        tristate "Sonos class device"
        depends on SONOS
        default n
        help
          Support for Sonos class device

config SONOS_DIAGS
        bool "Sonos diags"
        depends on SONOS
        default n
        help
          Support for Sonos diagnostics

config SONOS_EVENT_QUEUE
        tristate "Sonos Event Queue"
        depends on SONOS
        default n
        help
          Support for Sonos event queue module

config SONOS_LLA
        tristate "Sonos LLA"
        depends on SONOS && m
        default n
        help
          Support for Sonos Low Latency Audio module

config SONOS_ESAI
        bool "Sonos ESAI"
        depends on SONOS
        depends on SONOS_LLA
        default n
        help
          Support for Sonos ESAI driver

config SONOS_SSI
        bool "Sonos SSI"
        depends on SONOS
        depends on SONOS_LLA
        default n
        help
          Support for Sonos SSI driver

config SONOS_IMX_SPDIF
        bool "Sonos IMX_SPDIF"
        depends on SONOS
        depends on SONOS_LLA
        default n
        help
          Support for Sonos IMX_SPDIF driver

config SONOS_EPIT
        bool "Sonos EPIT"
        depends on SONOS
        depends on SONOS_LLA
        default n
        help
          Support for Sonos EPIT driver

config SONOS_MTK_GPT
        bool "Sonos MT8521P GPT"
        depends on SONOS
        depends on SONOS_LLA
        default n
        help
          Support for Sonos GPT driver for MTK chips

config SONOS_MT8521P_SOUND
        bool "Sonos MT8521P Sound"
        depends on SONOS
        depends on SONOS_LLA
        default n
        help
          Support for Sonos MT8521P audio driver

config SONOS_APPLE_AUTH
       tristate "Sonos Apple Authentication Chip driver"
       default n
       help
         Support for Sonos Apple auth driver

config SONOS_SENSORS
       tristate "Sonos Sensors driver"
       default n
       help
         Support for Sonos Sensors driver

config SONOS_S5851
       tristate "Sonos S5851 driver"
       default n
       help
         Support for Sonos S5851 driver

config SONOS_MTK_ADC_THERMISTOR
       tristate "Sonos MT8521P ADC Thermistor driver"
       default n
       help
         Support for Sonos MT8521P ADC Thermistor driver

config SONOS_THERMAL_MGMT
       tristate "Sonos Thermal Management driver"
       default n
       help
         Support for Sonos Thermal Management driver

config SONOS_BMA420
       tristate "Sonos BMA420 driver"
       default n
       help
         Support for Sonos BMA420 driver

config SONOS_LIS2HH12
       tristate "Sonos LIS2HH12 driver"
       default n
       help
         Support for Sonos LIS2HH12 driver

config SONOS_MMA8453Q
       tristate "Sonos MMA8453Q driver"
       default n
       help
         Support for Sonos MMA8453Q driver

config SONOS_CYPRESS_PSOC
       tristate "Sonos Cypress PSoC driver"
       default n
       help
         Support for Sonos Cypress PSoC driver

config SONOS_SDD
       tristate "Sonos SDD driver"
       default n
       help
         Support for Sonos SDD driver

config SONOS_LEDCTL
       tristate "Sonos LED control driver"
       default n
       help
         Support for Sonos LED control module

config SONOS_ADP8863
        tristate "Sonos ADP8863"
        depends on SONOS
        select SONOS_LEDCTL
        default n
        help
          Support for Sonos ADP8863 driver

config SONOS_PWM_LED
        tristate "Sonos PWM LEDs"
        depends on SONOS
        select SONOS_LEDCTL
        default n
        help
          Support for Sonos PWM LED driver

config SONOS_LP5562
        tristate "Sonos LP5562"
        depends on SONOS
        select SONOS_LEDCTL
        default n
        help
          Support for Sonos LP5562 driver

config SONOS_ICE40_LED
        tristate "Sonos iCE40 LED"
        depends on SONOS
        select SONOS_LEDCTL
        default n
        help
          Support for Sonos iCE40 FPGA LED driver

config SONOS_HDMICTL
        tristate "Sonos HDMI control driver"
        depends on SONOS
        default n
        help
         Support for Sonos HDMI control module

config SONOS_AMPCTL
       tristate "Sonos amp control driver"
       default n
       help
         Support for Sonos amp control module

config SONOS_I2C_AMPCTL
       tristate "Sonos amp control driver for I2C dac/amp"
       default n
       help
         Support for Sonos amp control module

config SONOS_AK4458
        bool "Sonos AK4458"
        depends on SONOS
        depends on SONOS_AMPCTL
        default n
        help
          Support for Sonos AK4458 driver

config SONOS_AK4613
        bool "Sonos AK4613"
        depends on SONOS
        depends on SONOS_AMPCTL
        default n
        help
          Support for Sonos AK4613 driver

config SONOS_PCM1690
        bool "Sonos PCM1690"
        depends on SONOS
        depends on SONOS_AMPCTL
        default n
        help
          Support for Sonos PCM1690 driver

config SONOS_TAS5720
        bool "Sonos TAS5720"
        depends on SONOS
        depends on SONOS_I2C_AMPCTL
        default n
        help
          Support for Sonos TAS5720 driver

config SONOS_AMPMCU
        bool "Sonos AMPMCU"
        depends on SONOS
        depends on SONOS_I2C_AMPCTL
        default n
        help
          Support for Sonos Amp MCU driver

config SONOS_MICCTL
       tristate "Sonos mic control driver"
       default n
       help
         Support for Sonos mic control module

config SONOS_PCM1864
        bool "Sonos PCM1864"
        depends on SONOS
        depends on SONOS_MICCTL
        default n
        help
          Support for Sonos PCM1864 driver

config SONOS_GPIO_MIC
        bool "Sonos GPIO Mic"
        depends on SONOS
        depends on SONOS_MICCTL
        default n
        help
          Support for Sonos GPIO microphone control

config SONOS_ICE40_MIC
        tristate "Sonos ICE40 Mic"
        depends on SONOS
        depends on SONOS_MICCTL && OF
        default n
        help
          Support for Sonos microphone control via iCE40

config SONOS_BLACKBOX
       tristate "Sonos blackbox kernel trace module"
       depends on SONOS
       default n
       help
         Support for Sonos blackbox module

config SONOS_LINEIN_OVERVOLT
        bool "Sonos Line-in overvolt"
        depends on SONOS
        depends on SONOS_SENSORS
        default n
        help
          Support for Sonos line-in overvolt driver

config SONOS_CABLE_GPIO_DETECT
        tristate "Sonos GPIO cable detection"
        depends on SONOS
        default n
        help
          Support for Sonos GPIO cable detection driver

config SONOS_BUTTONS
        bool "Sonos Buttons"
        depends on SONOS
        depends on SONOS_SENSORS
        default n
        help
          Support for Sonos generalized buttons driver

config SONOS_GPIO_BUTTONS
        tristate "Sonos Physical Buttons"
        depends on SONOS
        default n
        help
          Support for Sonos physical buttons driver

config SONOS_PSMON
       tristate "Sonos power supply monitoring (brownout detection) module"
       depends on SONOS
       default n
       help
         Support for Sonos power supply monitoring

config SONOS_CAAMKEYS
       tristate "Sonos i.MX6 CAAM module"
       depends on SONOS
       default n
       help
         Support for Sonos CAAM driver

config SONOS_MTK_CRYPTO_TEST
       tristate "Sonos module for testing MTK TEE crypto API"
       depends on SONOS
       default n
       help
         Support for Sonos MTK TEE crypto API testing

config SONOS_M4
       tristate "Sonos M4 module"
       depends on SONOS
       default n
       help
         Support for Sonos M4 driver

config SONOS_MTK_CM4
       tristate "Sonos Mediatek CM4 module"
       depends on SONOS
       default n
       help
         Support for Sonos Mediatek CM4 driver

config SONOS_ICE40_FPGA
       tristate "Sonos ICE40 FPGA module"
       depends on SONOS
       default n
       help
         Support for Sonos ICE40 FPGA driver

config SONOS_CHK
       tristate "Sonos check module"
       depends on SONOS
       default n
       help
         Support for Sonos check driver

config SONOS_SGE_ELREY
       tristate "Sonos PSoC/SGE image"
       depends on SONOS
       default n
       help
         Support for Sonos PSoC/SGE ElRey image

config SONOS_SGE_HIDEOUT_D1
       tristate "Sonos PSoC/SGE P1d image"
       depends on SONOS
       default n
       help
         Support for Sonos PSoC/SGE Hideout P1d image

config SONOS_SGE_HIDEOUT_D2
       tristate "Sonos PSoC/SGE image"
       depends on SONOS
       default n
       help
         Support for Sonos PSoC/SGE Hideout image

config SONOS_SGE_DOMINO
       tristate "Sonos PSoC/SGE image"
       depends on SONOS
       default n
       help
         Support for Sonos PSoC/SGE Domino image

config SONOS_SWD_BYPASS_GPIOLIB
       tristate "Sonos Bypass GPIO lib for faster bit banging"
       depends on SONOS
       default n
       help
         Support for Sonos GPIOLIB bypass

config SONOS_EEPROM
       tristate "Sonos i2c eeprom module"
       depends on SONOS
       default n
       help
         Support for Sonos i2c eeprom driver

config SONOS_IR_RCVR
       tristate "Sonos IR receiver module"
       depends on SONOS
       default n
       help
         Support for Sonos IR receiver driver

config SONOS_SECBOOT
        bool "Sonos Secure Boot"
        depends on SONOS
        depends on CRYPTO
        depends on CRYPTO_CBC
        depends on CRYPTO_CTR
        depends on CRYPTO_AES
        depends on CRYPTO_SHA1
        depends on CRYPTO_SHA256
        depends on ASYMMETRIC_KEY_TYPE
        depends on ASYMMETRIC_PUBLIC_KEY_SUBTYPE
        depends on PUBLIC_KEY_ALGO_RSA
        depends on X509_CERTIFICATE_PARSER
        default n
        help
          Support for Sonos Secure Boot stuff

config SONOS_BRIDGE_PROXY
        bool "Sonos Bridge Proxy"
        depends on SONOS
        default n
        help
          Support for Sonos Bridge Proxy

config SONOS_ROOTFS_MAX
        bool "Sonos Use Rootfs Max Size in Kernel Config"
        default n
        help
           Rootfs Max Size is used by virtual block module
           and rootfs mount
           To avoid using ifdef in the code, the
           SONOS_ROOTFS_MAX is defined here

config SONOS_ROOTFS_MAX_SIZE
        int "Sonos Max Rootfs Size in Decimal"
        depends on SONOS_ROOTFS_MAX
        default 0
        help
          Support for Sonos rootfs upgrade

config SONOS_ROOTFS_ADJUSTMENT
        hex "Sonos rootfs digest adjustment (virt to phys)"
        default 0x0
        help
          Support for Sonos rootfs upgrade

config SONOS_FUSE_CTRL
        tristate "Sonos Fuse Control"
        default n
        help
          Fuse Control GPIO

config SONOS_NXP3H2111_NFC
        tristate "Sonos NXP 3H2111 NFC driver"
        default n
        help
          Support for Sonos NXP 3H2111 NFC driver

config SONOS_DSPIC
	tristate "Sonos dsPIC33 image loader"
	depends on SONOS
	default n
	help
	  Sonos dsPIC33 image loader.

config SONOS_DEBUG_CORRUPT
	tristate "Sonos memory corruption detector"
	depends on SONOS
	default n
	help
	  Detects memory corruption related to the MT8521p "conn" power domain.
	  See debug_memory_corruption.patch

config SONOS_QCA_DDFA
	tristate "Sonos QCA DDFA image loader"
	depends on SONOS
	default n
	help
	  Sonos QCA DDFA image loader.
```

## arch/powerpc/Kconfig.sonos
```kconfig
config SONOS_DEVICE
        tristate "Sonos class device"
        default n
        help
          Support for Sonos class device

config SONOS_DIAGS
        bool "Sonos diags"
        default n
        help
          Support for Sonos diagnostics

config SONOS_CHK
       tristate "Sonos check module"
       default n
       help
         Support for Sonos check driver

config SONOS_AUDIODEV
       tristate "Sonos audiodev module"
       default n
       help
         Support for Sonos audiodev driver (connectx)
```

## drivers/amlogic/aes_hwkey_gcm/Kconfig
```kconfig
config	AES_HWKEY_GCM
	bool "AES-GCM using HW Unique Key"
	default y
	help
	  say y to enable
	  AES_HWKEY_GCM
```

## drivers/bluetooth/Kconfig
```kconfig
menu "Bluetooth device drivers"
	depends on BT

config BT_INTEL
	tristate
	select REGMAP

config BT_BCM
	tristate
	select FW_LOADER

config BT_RTL
	tristate
	select FW_LOADER

config BT_QCA
	tristate
	select FW_LOADER

config BT_HCIUART
	tristate "HCI UART driver"
	depends on TTY
	help
	  Bluetooth HCI UART driver.
	  This driver is required if you want to use Bluetooth devices with
	  serial port interface. You will also need this driver if you have
	  UART based Bluetooth PCMCIA and CF devices like Xircom Credit Card
	  adapter and BrainBoxes Bluetooth PC Card.

	  Say Y here to compile support for Bluetooth UART devices into the
	  kernel or say M to compile it as module (hci_uart).

config BT_HCIUART_H4
	bool "UART (H4) protocol support"
	depends on BT_HCIUART
	help
	  UART (H4) is serial protocol for communication between Bluetooth
	  device and host. This protocol is required for most Bluetooth devices
	  with UART interface, including PCMCIA and CF cards.

	  Say Y here to compile support for HCI UART (H4) protocol.

config BT_HCIUART_BCSP
	bool "BCSP protocol support"
	depends on BT_HCIUART
	select BITREVERSE
	help
	  BCSP (BlueCore Serial Protocol) is serial protocol for communication
	  between Bluetooth device and host. This protocol is required for non
	  USB Bluetooth devices based on CSR BlueCore chip, including PCMCIA and
	  CF cards.

	  Say Y here to compile support for HCI BCSP protocol.

config BT_HCIUART_3WIRE
	bool "Three-wire UART (H5) protocol support"
	depends on BT_HCIUART
	help
	  The HCI Three-wire UART Transport Layer makes it possible to
	  user the Bluetooth HCI over a serial port interface. The HCI
	  Three-wire UART Transport Layer assumes that the UART
	  communication may have bit errors, overrun errors or burst
	  errors and thereby making CTS/RTS lines unnecessary.

	  Say Y here to compile support for Three-wire UART protocol.

endmenu
```
