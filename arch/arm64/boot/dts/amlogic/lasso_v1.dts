// SPDX-License-Identifier: (GPL-2.0+ OR MIT)
/*
 * Copyright (c) 2021 Amlogic, Inc. All rights reserved.
 */

/dts-v1/;

#include "sm1_s905d3_ac200.dts"

&sd_emmc_a {
	status = "disabled";
};

&sd_emmc_b {
	status = "disabled";
};
