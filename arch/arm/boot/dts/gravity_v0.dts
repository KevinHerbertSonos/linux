/*
 * Copyright (c) 2020, Sonos, Inc.
 *
 * SPDX-License-Identifier:     GPL-2.0
 *
 * V0 - gravity version 0 - based on Titan
 */
#include "gravity.dtsi"

/ {
	model = "Sonos i.MX6 SoloX - Gravity V0";

};
