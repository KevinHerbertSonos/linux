## drivers/amlogic/cpufreq/Kconfig
```kconfig
config AMLOGIC_MESON_CPUFREQ
	tristate  "MESON based CPUfreq driver"
	default n
        help
          This adds the CPUfreq driver support for ARM big.LITTLE platforms
          using MESON dt for CPU power management.

          This driver uses meson cpufreq driver to interact with the
          firmware providing the CPU DVFS functionality.

config AMLOGIC_INPUT_BOOST
    bool "Meson BOOST cpufreq when key input"
    depends on CPU_FREQ_GOV_INTERACTIVE
    help
        This adds boost cpuferq support when key input detected.
        This adds boost cpuferq support when key input detected.
        When key input, cpufreq is boosted.
        And boost_duration is decideded by AMLOGIC_INPUT_BOOST_DURATION

config AMLOGIC_INPUT_BOOST_DURATION
    int "Input boost duration"
    range 0 5000
    default 1000
    depends on AMLOGIC_INPUT_BOOST
    help
        This set boost cpuferq duration.
        unit is ms.

	  this driver use mailbox communicate with uboot to do dvfs
```

## drivers/amlogic/firmware/Kconfig
```kconfig
#
# Amlogic firmware configuration
#
menu "AMLOGIC firmware boot"

config AMLOGIC_FIRMWARE
	tristate "firmware bootup support"
	default n
	help
		This option enables meson firmware driver which is
		used to boot up and control m4. Enable it, if want
		to use bl40_boot util to start up m4 or send data to m4.

endmenu
```

## lib/Kconfig.kfence
```kconfig
# SPDX-License-Identifier: GPL-2.0-only

config HAVE_ARCH_KFENCE
	bool

menuconfig KFENCE
	bool "KFENCE: low-overhead sampling-based memory safety error detector"
	depends on HAVE_ARCH_KFENCE && (SLAB || SLUB)
	select STACKTRACE
	select IRQ_WORK
	help
	  KFENCE is a low-overhead sampling-based detector of heap out-of-bounds
	  access, use-after-free, and invalid-free errors. KFENCE is designed
	  to have negligible cost to permit enabling it in production
	  environments.

	  See <file:Documentation/dev-tools/kfence.rst> for more details.

	  Note that, KFENCE is not a substitute for explicit testing with tools
	  such as KASAN. KFENCE can detect a subset of bugs that KASAN can
	  detect, albeit at very different performance profiles. If you can
	  afford to use KASAN, continue using KASAN, for example in test
	  environments. If your kernel targets production use, and cannot
	  enable KASAN due to its cost, consider using KFENCE.
```

## lib/crypto/Kconfig
```kconfig
# SPDX-License-Identifier: GPL-2.0

menu "Crypto library routines"

config CRYPTO_LIB_BLAKE2S_GENERIC
	def_bool !CRYPTO_ARCH_HAVE_LIB_BLAKE2S
	help
	  This symbol can be depended upon by arch implementations of the
	  Blake2s library interface that require the generic code as a
	  fallback, e.g., for SIMD implementations. If no arch specific
	  implementation is enabled, this implementation serves the users
	  of CRYPTO_LIB_BLAKE2S.

config CRYPTO_LIB_CURVE25519
	tristate "Curve25519 scalar multiplication library"
	depends on CRYPTO_ARCH_HAVE_LIB_CURVE25519 || !CRYPTO_ARCH_HAVE_LIB_CURVE25519
	select CRYPTO_LIB_CURVE25519_GENERIC if CRYPTO_ARCH_HAVE_LIB_CURVE25519=n
	select LIB_MEMNEQ
	help
	  Enable the Curve25519 library interface. This interface may be
	  fulfilled by either the generic implementation or an arch-specific
	  one, if one is available and enabled.

config CRYPTO_LIB_POLY1305_RSIZE
	int
	default 2 if MIPS
	default 11 if X86_64
	default 9 if ARM || ARM64
	default 1

endmenu
```
